## boards/riscv/milkv_duo_cv1800b/Kconfig.board
```kconfig
# Copyright (c) 2024 Junhui Liu <liujh2818@outlook.com>
# SPDX-License-Identifier: Apache-2.0

config BOARD_MILKV_DUO_CV1800B
	bool "Milk-V Duo CV1800B target"
	depends on SOC_SOPHGO_CV1800B
```

## boards/riscv/milkv_duo_cv1800b/Kconfig.defconfig
```kconfig
# Copyright (c) 2024 Junhui Liu <liujh2818@outlook.com>
# SPDX-License-Identifier: Apache-2.0

if BOARD_MILKV_DUO_CV1800B

config BOARD
	default "milkv_duo_cv1800b"

endif
```

## boards/riscv/milkv_duo_cv1800b/milkv_duo_cv1800b_defconfig
```kconfig
# SPDX-License-Identifier: Apache-2.0

# Platform Configuration
CONFIG_SOC_SERIES_SOPHGO_CV1800B=y
CONFIG_SOC_SOPHGO_CV1800B=y
CONFIG_BOARD_MILKV_DUO_CV1800B=y

# Clint Fix
CONFIG_RISCV_RDTIME_FROM_CSR=y
CONFIG_SET_MTIMECMP_32BIT=y

# Zephyr Kernel Configuration
CONFIG_XIP=n

# Serial Drivers
CONFIG_SERIAL=y

# Enable Console
CONFIG_CONSOLE=y
CONFIG_UART_CONSOLE=y

# Enable GPIO
CONFIG_GPIO=y
```

## soc/riscv/sophgo/Kconfig
```kconfig
# Copyright (c) 2024 Junhui Liu <liujh2818@outlook.com>
# SPDX-License-Identifier: Apache-2.0

config SOC_FAMILY_SOPHGO
	bool

if SOC_FAMILY_SOPHGO

config SOC_FAMILY
	string
	default "sophgo"

source "soc/riscv/sophgo/*/Kconfig.soc"

endif # SOC_FAMILY_SOPHGO
```

## soc/riscv/sophgo/Kconfig.defconfig
```kconfig
# SPDX-License-Identifier: Apache-2.0

source "soc/riscv/sophgo/*/Kconfig.defconfig.series"
```

## soc/riscv/sophgo/Kconfig.soc
```kconfig
# Copyright (c) 2024 Junhui Liu <liujh2818@outlook.com>
# SPDX-License-Identifier: Apache-2.0

source "soc/riscv/sophgo/*/Kconfig.series"
```

## soc/riscv/sophgo/cv1800b/Kconfig.defconfig.series
```kconfig
# Copyright (c) 2024 Junhui Liu <liujh2818@outlook.com>
# SPDX-License-Identifier: Apache-2.0

if SOC_SERIES_SOPHGO_CV1800B

config SOC_SERIES
	default "cv1800b"

config SYS_CLOCK_HW_CYCLES_PER_SEC
	default 25000000

config RISCV_SOC_INTERRUPT_INIT
	default y

config RISCV_GP
	default y

config 2ND_LVL_ISR_TBL_OFFSET
	default 12

config 2ND_LVL_INTR_00_OFFSET
	default 11

config NUM_IRQS
	default 73	# 61 + 2ND_LVL_ISR_TBL_OFFSET

endif # SOC_SERIES_SOPHGO_CV1800B
```

## soc/riscv/sophgo/cv1800b/Kconfig.series
```kconfig
# Copyright (c) 2024 Junhui Liu <liujh2818@outlook.com>
# SPDX-License-Identifier: Apache-2.0

config SOC_SERIES_SOPHGO_CV1800B
	bool "Sophgo CV1800B"
	select RISCV
	select RISCV_PRIVILEGED
	select RISCV_HAS_PLIC
	select SOC_FAMILY_SOPHGO
	help
	  Enable support for Sophgo CV1800B SoC.
```

## soc/riscv/sophgo/cv1800b/Kconfig.soc
```kconfig
# Copyright (c) 2024 Junhui Liu <liujh2818@outlook.com>
# SPDX-License-Identifier: Apache-2.0

choice
	prompt "Sophgo CV1800B SoC"
	depends on SOC_SERIES_SOPHGO_CV1800B

config SOC_SOPHGO_CV1800B
	bool "Sophgo CV1800B"
	select ATOMIC_OPERATIONS_BUILTIN
	select INCLUDE_RESET_VECTOR
	select 64BIT
	select RISCV_ISA_RV64I
	select RISCV_ISA_EXT_M
	select RISCV_ISA_EXT_A
	select RISCV_ISA_EXT_C
	select RISCV_ISA_EXT_ZICSR
	select RISCV_ISA_EXT_ZIFENCEI

endchoice
```
