/*
 * Copyright (C) 2024 Junhui Liu <liujh2818@outlook.com>
 *
 * SPDX-License-Identifier: Apache-2.0
 */

&i2c1 {
	sht3xd@44 {
		compatible = "sensirion,sht3xd";
		reg = <0x44>;
		alert-gpios = <&gpio0 15 GPIO_ACTIVE_LOW>;
	};
};
